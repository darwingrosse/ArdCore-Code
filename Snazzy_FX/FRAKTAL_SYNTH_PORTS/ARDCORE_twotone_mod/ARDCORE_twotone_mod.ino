
/*DANS PORT AND MODIFICATION OF THE TWO TONE DRONE....

ALL 4 knobs do stuff

DAC out is audio out */














/*

   Two Tone Drone Synthesizer



   yerpa58 (2010)



   Version 0.1 Two cross-fading oscillators with chorus.  Ring mod with separate envelope.



   Potentiometer assignments:



   pot 0 : Algorithm

   pot 1 : Cross Fade Speed

   pot 2 : Freq 1

   pot 3 : Freq 2

   pot 4 : Chorus Offset

   pot 5 : Chorus Env Speed

   pot 6 : Ring Mod Env Speed

   pot 7 : Vibrato Speed



   DELAY_BUFF[] is in application.c



*/



//

// global variables

//

boolean  REVERSE = true;

   byte  DRONE_out;

byte DELAY_BUFF[512];

   byte   lfo1;         // lfo1 is used for cross-fade speed.

   boolean   lfo1_dir;

   int  prescale1;

const int pinOffset = 5;       // the first DAC pin (from 5-12)

   byte   lfo2;         // lfo2 is used for chorus speed.

   boolean   lfo2_dir;

   int  prescale2;

   byte   vlfo2;

   boolean   vlfo2_dir;



   byte   lfo3;         // lfo3 is used for chorus amount.

   boolean  lfo3_dir;

   int  prescale3;



   byte   lfo4;         // lfo4 is used for ring mod envelope speed.

   boolean   lfo4_dir;

   int  prescale4;



   boolean  chorus_dir;

   int chorusptr1;

   int chorusptr2;

   int choruslen;



   int ringmod;

   byte  ring8;







// "API" Potentiometer 0..7 values:

// byte API_POT[8];





const int SCALEa[32] =

{

   311,   841,   363,  893,

   415,   944,   466,  996,
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  1036,  1566,  1088,  1618

};





const int SCALEb[32] =

{

   415,   944,   466,  996,

   518,  1048,   570,  1100,
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   933,  1463,   985,  1515

};





const int SCALEc[32] =

{

   1153,   1312,   1515,   1787,

   2132,   1594,   2099,   1731,
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   6607,   6377,   7437,   6924,

};





const int SCALEd[32] =

{

   2132,   1594,   2099,   1731,

   1153,   1312,   1515,   1787,
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   4700,   5249,   6060,   6187,

};



const int SCALEe[32] =

{

   3189,   4198,  3462,  3871,

   4475,   4326,  4396,  4700,
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   15978, 17303, 17585, 18798,

};



const int SCALEf[32] =

{

   4475,   4326,  4396,  4700,

   3189,   4198,  3462,  3871,
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   12754, 13913, 13848, 15482,

};



const int SCALEg[32] =

{

   1153,    1515,   1787,   1594,

   1731,    2237,   2163,   2350,
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   15482,  15978,  17303,  18798,

};



const int SCALEh[32] =

{

   1731,    2237,   2163,   2350,

   1153,    1515,   1787,   1594,
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   15482,  15978,  17303,  18798,

};





const byte WAV_TABLE1[1024] =

{

    127, 128, 129, 129,

	130, 131, 132, 132, 133, 134, 135, 136, 136, 137,
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	122, 123, 124, 125, 125, 126,

};



const byte WAV_TABLE2[1024] =

{

    127,  127,  128,  128,  129,  129,  130,  130,  131,  131,

	132,  132,  133,  133,  134,  134,  135,  135,  136,  136,
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	126,  126,  127,  127,

};


void setup () {


 
   // set up the 8-bit DAC output pins
  for (int i=0; i<8; i++) {
    pinMode(pinOffset+i, OUTPUT);
    digitalWrite(pinOffset+i, LOW);
  }
   }





void DSP_DRONE_Init (void)

{

   DRONE_out       = 0x7f;

}



void getnextnote(void)

{







}



byte DSP_DRONE (boolean reverse)

{



   static byte  acc1;

   static byte  acc2;



   static byte  atktime;



   static byte  chad;

   static byte  dcytime;



   static byte  idx1;

   static byte  idx2;



   static int noteptr1;

   static int noteptr2;



   static byte  prescale4;



   static byte  tmpamt;

   static byte  tmpbyte1;

   static byte  tmpbyte2;



   static int tmp1;

   static int tmp2;



//   noteptr1 = 88;                  //Just something to start with.

//   noteptr2 = 512;



   if (prescale1) prescale1--;

   if (prescale2) prescale2--;

   if (prescale3) prescale3--;

   if (prescale4) prescale4--;



   if (!prescale1)

   {

     prescale1 = analogRead(0);                // Get cross-fade speed.
int prescale;
    prescale <<= 4;

     if (lfo1==0xff) lfo1_dir = 0;

     if (!lfo1) lfo1_dir = 1;

     if (lfo1_dir) lfo1++;

     else lfo1--;

     if (!lfo1) noteptr1 = analogRead(1);       // Get new notes when each note faded to 0

     if (lfo1==0xff) noteptr2 = analogRead(2);

   }



   if (!prescale2)

   {

     //prescale2 = API_POT[4];



     prescale2 = vlfo2;



     if (vlfo2==0xff) vlfo2_dir = 0;

     if (!vlfo2) vlfo2_dir =1;

     if (vlfo2_dir) vlfo2++;

     else vlfo2--;



     if (lfo2==0xff) lfo2_dir = 0;

     if (!lfo2) lfo2_dir = 1;

     if (lfo2_dir) lfo2++;

     else lfo2--;

   }



   if (!prescale3)

   {

     prescale3 = analogRead(3);

     if (lfo3==0xff) lfo3_dir = 0;

     if (!lfo3) lfo3_dir = 1;

     if (lfo3_dir) lfo3++;

     else lfo3--;

   }



   if (!prescale4)

   {

     prescale4 = analogRead(4);

     if (lfo4==0xff) lfo4_dir = 0;

     if (!lfo4) lfo4_dir = 1;

     if (lfo4_dir) lfo4++;

     else lfo4--;

   }



   if (!lfo2)

   {

     if (chorusptr1==0x1ff) chorus_dir = 0;

     if (!chorusptr1) chorus_dir = 1;

     if (chorus_dir) chorusptr1++;

     else chorusptr1--;

   }



   idx1 += noteptr1;                     //Make next sample index for wave 1.

   idx1 &= 0x3ff;



   idx2 += noteptr2;                     //Make next sample index for wave 2.

   idx2 &= 0x3ff;



   acc1 = WAV_TABLE1[idx1];              //Cross-fade sample between two wavetables.

   acc2 = WAV_TABLE2[idx2];

   tmp1 = acc1*lfo1;

   tmpbyte1 = (byte) tmp1;



   tmpamt = 0xff - lfo1;

   tmp2 = acc2*tmpamt;

   tmpbyte2 = (byte)tmp2;

   tmpbyte1 >>=1;

   tmpbyte2 >>=1;



   DRONE_out = tmpbyte1 + tmpbyte2;      //Got raw cross-faded tone.



   ringmod = acc1* acc2;



   choruslen = analogRead(3);

   choruslen <<= 1;



   chorusptr1++;

   chorusptr1 &= 0x1ff;

   chorusptr2 = chorusptr1 + choruslen;

   chorusptr2 &= 0x1ff;



   DELAY_BUFF[chorusptr1] = DRONE_out;   //Record cros-faded note from osc 1.



//   DRONE_out >>= 1;



   acc1 = DELAY_BUFF[chorusptr2];        //Add chorus.

   tmp1 = acc1*lfo3;

   tmpbyte1 = (byte)tmp1;



   tmpamt = 0xff - lfo3;

   tmp2 = DRONE_out*tmpamt;

   tmpbyte2 = (byte)tmp2;

   tmpbyte1 >>=1;

   tmpbyte2 >>=1;



   DRONE_out = tmpbyte1 + tmpbyte2;      //Got raw cros-faded tone with chorus.



   ring8 = ringmod>>8;



   tmp1 = ring8*lfo4;

   tmp1 >>= 12;



   tmp2 = DRONE_out;

   tmp2 += tmp1;



   tmp2 <<=1;                           //Amplify.



   if (tmp2 > 0xff) tmp2 = 0xff;        //Saturate.

   DRONE_out = tmp2 & 0xff;             //Got cross-faded tone with chorus and ringmod.



//   tmpbyte1 >>= 1;

//   DRONE_out >>= 1;

//   tmp1 = DRONE_out + tmpbyte1;          //Possibility of overflow here.



//   DRONE_out = tmp1;



//   if (!prescale3)                         //Do attack/decay envelope

//   if (atktime)

//   {

//     atktime--;

//     prescale3 = API_POT[3];

//     tmp2 = _mul (DRONE_out, atktime);

//     tmpbyte2 = make8(tmp2, 1);

//     DRONE_out = tmpbyte2;

//   }

//   if (!atktime) if (dcytime) dcytime--;







//   if (!dcytime)

//   {

//      atktime = 0xff;

//      dcytime = 0xff;

//      getnextnote();

//   }



   return DRONE_out;



}



void loop () {
  
  int call=DSP_DRONE(REVERSE);

dacOutput( call);
}


//  dacOutput(long) - deal with the DAC output
//  ------------------------------------------
void dacOutput(long v)
{
 int tmpVal = v;
 bitWrite(PORTD, 5, tmpVal & 1);
 bitWrite(PORTD, 6, (tmpVal & 2) > 0);
 bitWrite(PORTD, 7, (tmpVal & 4) > 0);
 bitWrite(PORTB, 0, (tmpVal & 8) > 0);
 bitWrite(PORTB, 1, (tmpVal & 16) > 0);
 bitWrite(PORTB, 2, (tmpVal & 32) > 0);
 bitWrite(PORTB, 3, (tmpVal & 64) > 0);
 bitWrite(PORTB, 4, (tmpVal & 128) > 0);
}



